AUTOSAR XML (schema 4.0)
package /VehicleDataTypes
  8 x impl type, all with category=VALUE:
    VehicleSpeed_kmh: base-type=uint16, sw-value-cont=0, lower-limit=0, upper-limit=350
    EngineRPM: base-type=uint16, sw-value-cont=0, lower-limit=0, upper-limit=8000
    AcceleratorPedalPosition: base-type=uint8, sw-value-cont=0, lower-limit=0, upper-limit=100
    BrakePressure: base-type=uint16, sw-value-cont=0, lower-limit=0, upper-limit=1000
    SteeringAngle: base-type=int16, sw-value-cont=0, lower-limit=-720, upper-limit=720
    BooleanType: base-type=boolean
    EngineTemperature: base-type=int16, sw-value-cont=20, lower-limit=-40, upper-limit=150
    FuelLevel: base-type=uint8, sw-value-cont=50, lower-limit=0, upper-limit=100
package /VehicleECUConfiguration
  4 x ecu instance, all with category=ECU:
    ECM_ECU
    BCM_ECU
    BRM_ECU
    ICM_ECU
package /VehicleSystems
  system CompleteVehicleSystem: category=SYSTEM
    4 x component ref:
      EngineManagementSWC
      BrakeControlSWC
      BodyControlSWC
      InstrumentClusterSWC
package /VehicleMappings
  system mapping VehicleSystemMapping: system=CompleteVehicleSystem
    4 x swc to ecu mapping:
      EngineManagementMapping: swc-instance=EngineManagementSWC, ecu-instance=ECM_ECU
      BrakeControlMapping: swc-instance=BrakeControlSWC, ecu-instance=BCM_ECU
      BodyControlMapping: swc-instance=BodyControlSWC, ecu-instance=BRM_ECU
      InstrumentClusterMapping: swc-instance=InstrumentClusterSWC, ecu-instance=ICM_ECU
package /ApplicationTiming
  application interval EngineDataSamplingInterval
    interval event EngineDataSamplingEvent: period=10000, start-on-event=EngineRunningMode
  application interval VehicleSpeedSamplingInterval
    interval event VehicleSpeedSamplingEvent: period=5000
  application interval BrakeDataSamplingInterval
    interval event BrakeDataSamplingEvent: period=2000
  mode declaration group EngineMode
    mode EngineRunningMode
    mode EngineStoppedMode
  mode declaration group prototype EngineRunningMode: type=EngineMode
