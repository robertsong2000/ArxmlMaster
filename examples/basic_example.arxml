AUTOSAR XML (schema 4.0)
package /TestPackage
  system TestSystem: category=SYSTEM
package /AnotherPackage
  ecu instance TestECU: category=ECU
