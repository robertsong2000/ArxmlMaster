AUTOSAR XML (schema 4.0)
package /123InvalidPackage
  elements implementation-data-type={category=VALUE, base-type=NonExistentType}:
    impl type Speed-Type@Invalid: category=VALUE
ar-package:
  system InvalidSystem: category=SYSTEM
package /DuplicatePackage
  system DuplicateSystem: category=SYSTEM
    component ref SomeComponent
package /DuplicatePackage
  system AnotherSystem: category=SYSTEM
package /Package$Invalid%Chars
  application software component type SWC_With@Invalid#Name
    swc implementation SomeImplementation: behavior=Behavior
