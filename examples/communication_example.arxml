AUTOSAR XML (schema 4.0)
standard types defined: uint8, uint16, uint32
package /CommDataTypes
  impl type CAN_Signal_8bit: category=VALUE, base-type=uint8, sw-value-cont=0, lower-limit=0, upper-limit=255
  impl type CAN_Signal_16bit: category=VALUE, base-type=uint16, sw-value-cont=0, lower-limit=0, upper-limit=65535
  impl type CAN_Signal_32bit: category=VALUE, base-type=uint32, sw-value-cont=0, lower-limit=0, upper-limit=4294967295
package /CANCommunication
  can cluster VehicleCanNetwork: category=CAN, can-addressing-mode=NORMAL
    can frame processing CanFrameProcessing
      frame EngineDataMessage: 
      frame VehicleStatusMessage: 
    can physical channel CanPhysicalChannel1: frame-triggerings=[EngineDataFrame, VehicleStatusFrame]
  can frame EngineDataMessage: frame-type=STANDARD, can-addressing-mode=NORMAL, frame-length=8, message-can-id=0x123, pdu-triggering=EngineDataIPDU
  can frame VehicleStatusMessage: frame-type=STANDARD, can-addressing-mode=NORMAL, frame-length=8, message-can-id=0x456, pdu-triggering=VehicleStatusIPDU
  6 x i signal:
    EngineRPM_Signal: system-signal=EngineRPM_SystemSignal
    EngineTemp_Signal: system-signal=EngineTemp_SystemSignal
    ThrottlePos_Signal: system-signal=ThrottlePos_SystemSignal
    VehicleSpeed_Signal: system-signal=VehicleSpeed_SystemSignal
    BrakeStatus_Signal: system-signal=BrakeStatus_SystemSignal
    SteeringAngle_Signal: system-signal=SteeringAngle_SystemSignal
package /SystemSignals
  6 x system signal:
    EngineRPM_SystemSignal: base-type=uint16, sw-value-cont=800, lower-limit=0, upper-limit=8000
    EngineTemp_SystemSignal: base-type=uint8, sw-value-cont=90, lower-limit=-40, upper-limit=150
    ThrottlePos_SystemSignal: base-type=uint8, sw-value-cont=0, lower-limit=0, upper-limit=100
    VehicleSpeed_SystemSignal: base-type=uint16, sw-value-cont=0, lower-limit=0, upper-limit=300
    BrakeStatus_SystemSignal: base-type=uint8, sw-value-cont=0, lower-limit=0, upper-limit=255
    SteeringAngle_SystemSignal: base-type=int16, sw-value-cont=0, lower-limit=-720, upper-limit=720
package /Communication
  can frame port EngineDataFramePort
  can frame port VehicleStatusFramePort
