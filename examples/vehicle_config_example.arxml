AUTOSAR XML (schema 4.0)
standard types defined: uint8, uint16, boolean
package /DataTypes
  impl type VehicleSpeed_kmh: category=VALUE, base-type=uint16, sw-value-cont=0, lower-limit=0, upper-limit=350
  impl type EngineRPM: category=VALUE, base-type=uint16, sw-value-cont=0, lower-limit=0, upper-limit=8000
  impl type BooleanType: category=VALUE, base-type=boolean
package /VehicleInterfaces
  sender receiver interface IVehicleInfo
    data Speed_kmh: type=VehicleSpeed_kmh
    data EngineRPM: type=EngineRPM
    data EngineRunning: type=BooleanType
  sender receiver interface IVehicleControl
    data ThrottlePosition: type=VehicleSpeed_kmh
    data BrakePedalPressed: type=BooleanType
package /ECU_Configuration
  ecu instance EngineECU: ecu-configuration=EngineECU_Config
  ecu configuration EngineECU_Config: connector=EngineAppClusterConnector, diagnostic-address=0x710
    can channel EngineCAN: network-representation=EngineCAN
      frame EngineStatus: port=EngineInfoPort
  application software cluster connector EngineAppClusterConnector: application-software-cluster=EngineSoftwareCluster
package /Components
  application software component type EngineControlSWC
    sender receiver port EngineInfoPort: provided-interface=IVehicleInfo, data-elements=[Speed_kmh, EngineRPM, EngineRunning]
    sender receiver port ControlPort: required-interface=IVehicleControl, data-elements=[ThrottlePosition, BrakePedalPressed]
    behavior EngineControl_IB
      runnable-entities:
        runnable CalculateEngineStatus
  application software cluster EngineSoftwareCluster: application-software-component-type=EngineControlSWC
package /Network
  physical can channel EngineCAN: frame-triggerings=FRAME-TRIGGERING-0
  can frame EngineStatus: frame-length=8
    pdu mapping EngineStatusMapping: pdu=EngineStatus_PDU
  can i pdu EngineStatus_PDU: length=8, can-payload-type=EngineStatus_Payload
  can payload type EngineStatus_Payload: length=8, byte-order=big-endian
