AUTOSAR XML (schema 4.0)
package /DataTypes
  impl type VehicleSpeedType: category=VALUE, base-type=uint16, sw-value-cont=0, lower-limit=0, upper-limit=300
  impl type EngineRPMType: category=VALUE, base-type=uint16, sw-value-cont=0, lower-limit=0, upper-limit=8000
package /VehicleSystem
  system VehicleControlSystem: category=SYSTEM
    component ref EngineControlSWC
    component ref DisplaySWC
package /SoftwareComponents
  application software component type EngineControlSWC
    provide port EngineDataPPort: provided-interface=EngineDataInterface
    swc implementation EngineControlImplementation: behavior=EngineControlBehavior
  application software component type DisplaySWC
    require port DisplayDataRPort: required-interface=EngineDataInterface
package /Interfaces
  sender receiver interface EngineDataInterface
    data VehicleSpeed: type=VehicleSpeedType
    data EngineRPM: type=EngineRPMType
package /Mappings
  system mapping VehicleSystemMapping: system=VehicleControlSystem
    swc to ecu mapping EngineSWCMapping: swc-instance=EngineControlSWC, ecu-instance=EngineECU
    swc to ecu mapping DisplaySWCMapping: swc-instance=DisplaySWC, ecu-instance=DisplayECU
package /ECUs
  ecu instance EngineECU: category=ECU
  ecu instance DisplayECU: category=ECU
