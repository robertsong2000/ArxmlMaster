AUTOSAR XML (schema 4.0)
package /123InvalidName
  elements implementation-data-type=category=VALUE:
    sender receiver interface DuplicateName
    sender receiver interface DuplicateName
