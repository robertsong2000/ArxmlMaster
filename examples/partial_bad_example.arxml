AUTOSAR XML (schema 4.0)
package /GoodPackage
  system GoodSystem: category=SYSTEM
package /PackageWithExtraElements
  system SystemWithExtra: category=SYSTEM, extra-element=Extra content, another-extra=More extra
package /PackageMissingCategory
  ecu instance ECUWithoutCategory
